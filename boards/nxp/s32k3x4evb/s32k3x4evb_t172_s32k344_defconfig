## boards/nxp/s32k3x4evb/s32k3x4evb_t172_s32k344_defconfig
```kconfig
# SPDX-FileCopyrightText: Copyright The Zephyr Project Contributors
# SPDX-License-Identifier: Apache-2.0

# Enable MPU
CONFIG_ARM_MPU=y
CONFIG_CLOCK_CONTROL=y
CONFIG_GPIO=y
CONFIG_FLASH=y
CONFIG_SERIAL=y
CONFIG_CONSOLE=y
CONFIG_UART_CONSOLE=y
CONFIG_LOG=y
CONFIG_LOG_BACKEND_UART=y
CONFIG_CAN=y
CONFIG_CAN_MCUX_FLEXCAN=y
CONFIG_XIP=y
CONFIG_MDIO=y
CONFIG_ETH_NXP_S32_NETC=y
```
